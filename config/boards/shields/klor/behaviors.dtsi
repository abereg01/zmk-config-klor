/ {
    behaviors {

        mo_tog: mo_tog {
            compatible = "zmk,behavior-hold-tap";
            label = "MO_TOG";
            #binding-cells = <2>;
            tapping-term-ms = <200>;
            flavor = "hold-preferred";
            bindings = <&mo>, <&tog>;
        };

        hm: homerow_mods {
            compatible = "zmk,behavior-hold-tap";
            label = "HOMEROW_MODS";
            #binding-cells = <2>;
            flavor = "balanced";           // resolves hold/tap based on key-up, not time
            tapping-term-ms = <280>;       // generous window — require-prior-idle does the heavy lifting
            quick-tap-ms = <175>;          // repeat key if tapped twice quickly (e.g. fast space)
            require-prior-idle-ms = <150>; // if a key was pressed <150ms ago, always tap — kills rolling misfires
            hold-trigger-on-release;       // hold decision deferred until you release, not when next key is pressed
            bindings = <&kp>, <&kp>;
        };

    };
};
