## config/boards/shields/klor/Kconfig.defconfig
```kconfig
# Copyright (c) 2025
# SPDX-License-Identifier: MIT

if SHIELD_KLOR_DONGLE

config ZMK_KEYBOARD_NAME
    default "KLOR"

# Make this build act as the central (dongle)
config ZMK_SPLIT_ROLE_CENTRAL
    default y

# USB on the dongle so it talks to the host
config ZMK_USB
    default y

# Optional but helpful when using a central with two peripherals
config ZMK_SPLIT_BLE_CENTRAL_PERIPHERALS
    default 2

# 2 peripherals + up to 5 host slots = 7
config BT_MAX_CONN
    default 7
config BT_MAX_PAIRED
    default 7

endif

# All KLOR variants (L/R/Dongle) are part of a split & use BLE
if SHIELD_KLOR_LEFT || SHIELD_KLOR_RIGHT || SHIELD_KLOR_DONGLE

config ZMK_SPLIT
    default y

config ZMK_BLE
    default y

endif
```

## config/boards/shields/klor/Kconfig.shield
```kconfig
# Copyright (c) 2025 The ZMK Contributors
# SPDX-License-Identifier: MIT

config SHIELD_KLOR_LEFT
    def_bool $(shields_list_contains,klor_left)

config SHIELD_KLOR_RIGHT
    def_bool $(shields_list_contains,klor_right)

config SHIELD_KLOR_DONGLE
    def_bool $(shields_list_contains,klor_dongle)
```

## config/west.yml
```yaml
manifest:
  remotes:
    - name: zmkfirmware
      url-base: https://github.com/zmkfirmware
    - name: abereg01
      url-base: https://github.com/abereg01
  projects:
    - name: zmk
      remote: zmkfirmware
      revision: v0.3
      import: app/west.yml
    - name: prospector
      remote: abereg01
      revision: main
  self:
    path: config
```
